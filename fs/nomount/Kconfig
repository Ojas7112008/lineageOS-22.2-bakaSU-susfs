## fs/nomount/Kconfig
```kconfig
# Kconfig for NoMount

config NOMOUNT
	bool "NoMount Path Redirection Subsystem"
	depends on ARM64 && KEYS
	default n
	help
	  NoMount allows path redirection and virtual file injection
	  without mounting filesystems. Useful for systemless modifications.
```
